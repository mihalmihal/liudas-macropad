## config/boards/shields/liudas_macropad/Kconfig.defconfig
```kconfig
if SHIELD_LIUDAS_MACROPAD

config ZMK_KEYBOARD_NAME
    default "liudas_macropad"

endif
```

## config/boards/shields/liudas_macropad/Kconfig.shield
```kconfig
config SHIELD_LIUDAS_MACROPAD
    def_bool $(shields_list_contains,liudas_macropad)
```
