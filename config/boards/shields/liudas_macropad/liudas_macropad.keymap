#include <behaviors.dtsi>
#include <dt-bindings/zmk/keys.h>
#include <dt-bindings/zmk/outputs.h>

/ {
    keymap {
        compatible = "zmk,keymap";

        default_layer {
            bindings = <
                &kp LA(NUMBER_8) &kp LS(A) &kp LA(NUMBER_9) &kp LA(LG(K)) &kp LA(LG(B)) &kp LS(LG(BACKSLASH)) &kp LA(LG(C)) &kp LA(LG(V)) &kp LS(LG(R))
            >;
        };
    };
};